## conf/layer.conf
```bitbake
# We have a conf and classes directory, add to BBPATH
BBPATH .= ":${LAYERDIR}"

# We have recipes-* directories, add to BBFILES
BBFILES += "${LAYERDIR}/recipes-*/*/*.bb \
            ${LAYERDIR}/recipes-*/*/*.bbappend"

BBFILE_COLLECTIONS += "mender-kernel"
BBFILE_PATTERN_mender-kernel = "^${LAYERDIR}/"

INHERIT += "mender-kernel-vars"

LAYERDEPENDS_mender-kernel  = "                               \
                                core                          \
                                mender                        \
                                bitbake-variable-substitution \
                              "
LAYERDEPENDS_mender-kernel += "${@bb.utils.contains("DISTRO_FEATURES", "efi-secure-boot", "efi-secure-boot", "", d)}"

LAYERSERIES_COMPAT_mender-kernel = "kirkstone"
```
